## platform/esp32s31/Kconfig
```kconfig
# SPDX-License-Identifier: BSD-2-Clause

config PLATFORM_ESP32S31
	bool
	select SERIAL_ESP_UART
	default y
```

## platform/esp32s31/configs/defconfig
```kconfig
# SPDX-License-Identifier: BSD-2-Clause

# ESP32-S31 platform configuration for OpenSBI
# Build with: make PLATFORM=esp32s31 PLATFORM_RISCV_XLEN=32 PLATFORM_RISCV_ISA=rv32imac CROSS_COMPILE=riscv32-unknown-elf-

CONFIG_PLATFORM_ESP32S31=y
```
